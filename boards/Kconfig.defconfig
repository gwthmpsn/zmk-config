## boards/Kconfig.defconfig
```kconfig
if SHIELD_TRACTYL_MANUFORM_4X5_LEFT

config ZMK_KEYBOARD_NAME
    default "Tractyl 4x5 Left"

config ZMK_SPLIT_BLE_ROLE_CENTRAL
    default y

endif

if SHIELD_TRACTYL_MANUFORM_4X5_RIGHT

config ZMK_KEYBOARD_NAME
    default "Tractyl 4x5 Right"

endif

if SHIELD_TRACTYL_MANUFORM_4X5_LEFT || SHIELD_TRACTYL_MANUFORM_4X5_RIGHT

config ZMK_SPLIT
    default y
endif
```

## boards/Kconfig.shield
```kconfig
config SHIELD_ECLIPTIC_LEFT
    def_bool $(shields_list_contains,ecliptic_left)

config SHIELD_ECLIPTIC_RIGHT
    def_bool $(shields_list_contains,ecliptic_right)
```

## config/boards/shields/chocofi/Kconfig.defconfig
```kconfig
if SHIELD_CHOCOFI_LEFT

config ZMK_KEYBOARD_NAME
    default "Chocofi Left"

config ZMK_SPLIT_BLE_ROLE_CENTRAL
    default y

config ZMK_USB
    default y

endif

if SHIELD_CHOCOFI_RIGHT

config ZMK_KEYBOARD_NAME
    default "Chocofi Right"
    

endif

if SHIELD_CHOCOFI_LEFT || SHIELD_CHOCOFI_RIGHT

config ZMK_SPLIT
    default y
endif
```

## config/boards/shields/ecliptic/Kconfig.defconfig
```kconfig
if SHIELD_ECLIPTIC_LEFT

config ZMK_KEYBOARD_NAME
    default "Ecliptic Left"

endif

if SHIELD_ECLIPTIC_RIGHT

config ZMK_KEYBOARD_NAME
    default "Ecliptic Right"
    
config ZMK_SPLIT_BLE_ROLE_CENTRAL
    default y
    
config ZMK_USB
    default y
endif

if SHIELD_ECLIPTIC_LEFT || SHIELD_ECLIPTIC_RIGHT

config ZMK_SPLIT
    default y
endif
```

## config/boards/shields/tracktyl/Kconfig.defconfig
```kconfig
if SHIELD_TRACKTYL_LEFT

    config ZMK_KEYBOARD_NAME
        default "Tracktyl (Left)"

endif

if SHIELD_TRACKTYL_RIGHT

    config ZMK_KEYBOARD_NAME
        default "Tracktyl (Right)"

    config ZMK_SPLIT_BLE_ROLE_CENTRAL
        default y
	
	config PMW3389
		bool
		default y

endif

if SHIELD_TRACKTYL_LEFT || SHIELD_TRACKTYL_RIGHT

    config ZMK_SPLIT
        default y
        
    config ZMK_USB
        default y
endif
```

## config/west.yml
```yaml
manifest:
  remotes:
    - name: gwthmpsn
      url-base: https://github.com/gwthmpsn
  projects:
    - name: zmk
      remote: gwthmpsn
      revision: pmw3389-zmk3.2
      import: app/west.yml
  self:
    path: config
```
